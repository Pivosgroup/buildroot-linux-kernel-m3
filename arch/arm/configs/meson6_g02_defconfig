## arch/arm/mach-meson3/Kconfig
```kconfig
menu "Meson3 platform type"
	depends on ARCH_MESON3

config MACH_MESON3_REFF01
	select GENERIC_ALLOCATOR
	bool "Support M3 (M3_SKT_V1) platform"
	help
	  Include support for the AMLOGIC M3 Socket Emulation Baseboard platform.

config MACH_MESON3_REFF02
	select GENERIC_ALLOCATOR
	bool "Support M3 (WA) platform"
	help
	  Include support for the WA M3 board platform.
	  
config MACH_MESON3_REFF03
	select GENERIC_ALLOCATOR
	bool "Support M3 (Shuttle) platform"
	help
	  Include support for the Shuttle M3 board platform.	  

config MACH_MESON3_REFF04
	select GENERIC_ALLOCATOR
	bool "Support M3 (Ramos) platform"
	help
	  Include support for the Ramos M3 board platform.

config MACH_MESON3_REFF05
	select GENERIC_ALLOCATOR
	bool "Support M3 (SOCKET) platform"
	help
	  Include support for the AML M3 socket board platform.

config MACH_MESON3_REFF06
	select GENERIC_ALLOCATOR
	bool "Support M3 (Ainol) platform"
	help
	  Include support for the AML M3 socket board platform.

config MACH_MESON3_REFF07
	select GENERIC_ALLOCATOR
	bool "Support M3 (Malata) platform"
	help
	  Include support for the AML M3 Malata board platform.
	    
config MACH_MESON3_REFF08
	select GENERIC_ALLOCATOR
	bool "Support M3 F08 platform"
	help
	  Include support for the AML M3 socket board platform.

config MACH_MESON3_REFF09
	select GENERIC_ALLOCATOR
	bool "Support M3 F09 platform"
	help
	  Include support for the AML M3 board platform.

config MACH_MESON3_REFF10
	select GENERIC_ALLOCATOR
	bool "Support M3 (Asus) MBX platform"
	help
	  Include support for the Asus M3 board platform.

config MACH_MESON3_REFF11
	select GENERIC_ALLOCATOR
	bool "Support M3 (Gadmei) platform"
	help
	  Include support for the AML M3 Gadmei board platform.

config MACH_MESON3_REFF11_P800
	select GENERIC_ALLOCATOR
	bool "Support M3 (Gadmei Portrait 1280*800)"
	help
	  Include support for the AML M3 Gadmei board platform.

config MACH_MESON3_REFF11_4329
	select GENERIC_ALLOCATOR
	bool "Support M3 (Gadmei BC 4329)"
	help
	  Include support for the AML M3 Gadmei board platform.

config MACH_MESON3_REFF14
	select GENERIC_ALLOCATOR
	bool "Support MT720 (Keenhi M3 1024*600) platform"
	help
	  Include support for the Keenhi M3 board platform.

config MACH_MESON3_REFF16
	select GENERIC_ALLOCATOR
	bool "Support M3 MBX platform"
	help
	  Include support for the Ref M3 board platform.
	  
config MACH_MESON3_REFF16_GBOX
        select GENERIC_ALLOCATOR
        bool "Support M3(GBox) MBX platform"
        help
          Include support for the Ref M3 board platform.

config MACH_MESON3_REFF16_GBOX_1
        select GENERIC_ALLOCATOR
        bool "Support M3(GBox 2.1) MBX platform"
        help
          Include support for the Ref M3 board platform.

config MACH_MESON3_REFF16_BLUEM3
        select GENERIC_ALLOCATOR
        bool "Support M3(Bluetimes) MBX platform"
        help
          Include support for the Ref M3 board platform.

config MACH_MESON3_REFF16_1
	select GENERIC_ALLOCATOR
	bool "Support M3(lenovo) MBX platform"
	help
	  Include support for the Ref M3 board platform.	  

config MACH_MESON3_REFF16_DONGLE
	select GENERIC_ALLOCATOR
	bool "Support M3(dongle) MBX platform"
	help
	  Include support for the Ref M3 board platform.
	  
config MACH_MESON3_REFF20
	select GENERIC_ALLOCATOR
	bool "Support M3 Bestv MBX platform"
	help
	  Include support for the Ref M3 board platform.

config MACH_MESON3_REFF33
        select GENERIC_ALLOCATOR
        bool "Support M3 PBI MBX platform"
        help
          Include support for the PBI M3 board platform.

config MACH_MESON3_REFF34
        select GENERIC_ALLOCATOR
        bool "Support M3 NGN MBX platform"
        help
          Include support for the NGN M3 board platform.

config MACH_MESON3_REFF34_1
        select GENERIC_ALLOCATOR
        bool "Support M3 NGN MBX platform"
        help
          Include support for the NGN M3 board platform.

config MACH_MESON3_REFF34_2
        select GENERIC_ALLOCATOR
        bool "Support M3 NGN MBX platform"
	help
          Include support for the NGN M3 board platform.

config MESON3_CLOCK_TICK_RATE
    int "Clock Tick Rate"
	default 25000000

config AML_SUSPEND
		bool "Support M3 A9 domain power down"
		depends on SUSPEND
		default n

config SCREEN_ON_EARLY
	bool "Turn on screen early"
	depends on AML_SUSPEND
	default n
		
config SUSPEND_WATCHDOG
	bool "Enable watchdog while suspend and resume"
	depends on AML_SUSPEND
	default n

config AML_INIT_GATE_OFF
	bool "turn the gates off when system init"
	default n
	
config CLK81_DFS
	bool "scale clk81 freqence in dynamic mode"
	default n

config AML_SUSPEND_FIRMWARE_BASE
	hex
	default 0x1ff00000
	depends on AML_SUSPEND
	help
	  The base address of 1MB of memory to be reserved for suspend firmware.

config MACH_MESON3_STV_MBX_MC
	select GENERIC_ALLOCATOR
	bool "Support M3 (geniatech) platform"
	help
		Include support for the AML M3 geniatech board platform.

config MACH_MESON3_STV_MBX_MC_A11
        select GENERIC_ALLOCATOR
        bool "Support M3 (MyGica A11) platform"
        help
                Include support for the AML M3 MyGica A11 board platform.

config STV_RECOVERY
	bool "make recovery partition visible"
	default n

endmenu
```

## drivers/amlogic/Kconfig
```kconfig
#
# Amlogic driver configuration
#
menu "Amlogic Device Drivers"
	depends on AMLOGIC_SERIES
#
#	Char devices
#
comment "Char devices"
source "drivers/amlogic/uart/Kconfig"
source "drivers/amlogic/rtc/Kconfig"
source "drivers/amlogic/i2c/Kconfig"
source "drivers/amlogic/input/Kconfig"
source "drivers/amlogic/power/Kconfig"
source "drivers/amlogic/light_sensor/Kconfig"
source "drivers/amlogic/extern_io/Kconfig"
source "drivers/amlogic/gpio/Kconfig"
source "drivers/amlogic/minilvds/Kconfig"
source "drivers/amlogic/efuse/Kconfig"
source "drivers/amlogic/smartcard/Kconfig"
source "drivers/amlogic/gps/Kconfig"
source "drivers/amlogic/boot_monitor/Kconfig"

#	Block devices
#
comment "Block devices"
source "drivers/amlogic/usb/Kconfig"
source "drivers/amlogic/sata/Kconfig"
source "drivers/amlogic/cardreader/Kconfig"
source "drivers/amlogic/spi_nor/Kconfig"
source "drivers/amlogic/nand/Kconfig"
source "drivers/amlogic/demod/Kconfig"


#
#	Network devices
#
comment "Network devices"
source "drivers/amlogic/net/Kconfig"
source "drivers/amlogic/wifi/Kconfig"
source "drivers/amlogic/bluetooth/Kconfig"

#
#	Media devices
#
comment "Media devices"
source "drivers/amlogic/canvas/Kconfig"
source "drivers/amlogic/display/Kconfig"
source "drivers/amlogic/amports/Kconfig"
source "drivers/amlogic/hdmi/Kconfig"
source "drivers/amlogic/tvin/Kconfig"
source "drivers/amlogic/amaudio/Kconfig"
source "drivers/amlogic/audiodsp/Kconfig"
source "drivers/amlogic/cmem/Kconfig"
source "drivers/amlogic/jpeglogo/Kconfig"
source "drivers/amlogic/ump/Kconfig"
source "drivers/amlogic/mali/Kconfig"
source "drivers/amlogic/dvb/Kconfig"
source "drivers/amlogic/ppmgr/Kconfig"
source "drivers/amlogic/audiodsplog/Kconfig"
source "drivers/amlogic/deinterlace/Kconfig"

#
#	camera devices
#
source "drivers/amlogic/camera/Kconfig"

source "drivers/amlogic/modem/Kconfig"

source "drivers/amlogic/debug/Kconfig"
endmenu	
```

## drivers/amlogic/amaudio/Kconfig
```kconfig
# AML AUDIO control drivers

menu "Amlogic Audio Interface"

config	AMAUDIO
	tristate "Amlogic Audio Interface"
    default y
	help
		"AMLogic Audio Interface"
	
endmenu	
```

## drivers/amlogic/amports/Kconfig
```kconfig
#
# AMLOGIC streaming device configuration
#

menu "AMLOGIC AV Streaming devices"

config AM_VIDEO
	bool "AMLOGIC Video management"
	default y
	select AM_CANVAS
	select AM_PTSMGR
	select AM_TIMESYNC
	help
	  Driver for video display.

config AM_VIDEO2
	bool "AMLOGIC Video2 management"
	default n
	select AM_VIDEO
	help
	  Driver for video2 display.

config AM_PTSSERVER
	bool

config AM_VDEC_MPEG12
	tristate "AMLOGIC MPEG1/2 Video Decoder"
	default y
	select AM_VIDEO
	select AM_PTSSERVER
	help
	  Driver for mpeg1/2 video decoder.

config AM_VDEC_MPEG4
	tristate "AMLOGIC MPEG4 Video Decoder"
	default y
	select AM_VIDEO
	select AM_PTSSERVER
	help
	  Driver for mpeg4 video decoder.

config AM_VDEC_VC1
	tristate "AMLOGIC VC1 Video Decoder"
	default y
	select AM_VIDEO
	select AM_PTSSERVER
	help
	  Driver for vc1 video decoder.

menuconfig AM_VDEC_H264
	tristate "AMLOGIC H264 Video Decoder"
	default y
	select AM_VIDEO
	select AM_PTSSERVER
	help
	  Driver for h264 video decoder.

if AM_VDEC_H264
        config AM_VDEC_H264_DECODER_MEM_SIZE
        int "AMLOGIC H264 HW Decoder memory size in mb"
        default 32
        range 32 64
        help
          H264 decoder may reqire more memory than other video format to handle more reference frames.
          The maximum supported reference frame number is limited by the memory size defined here.
endif #AM_VDEC_H264

config AM_VDEC_H264MVC
	tristate "AMLOGIC H264MVC Video Decoder"
	default y
	select AM_VIDEO
	select AM_PTSSERVER
	help
	  Driver for h264mvc video decoder.

config AM_VDEC_MJPEG
	tristate "AMLOGIC Motion JPEG Video Decoder"
	default y
	select AM_VIDEO
	select AM_PTSSERVER
	help
	  Driver for motion jpeg video decoder.

config AM_VDEC_REAL
	tristate "AMLOGIC Real Video Decoder"
    default y
    select AM_VIDEO
	select AM_PTSSERVER
    help
      Driver for real video decoder.

config AM_JPEGDEC
    tristate "AMLOGIC HW jpeg decoder"
    default y
    select AM_VIDEO
	select AM_PTSSERVER
	help
	  Select to enable HW jpeg decoder.

config AM_TIMESYNC
	bool "AMLOGIC Time sync driver"
	default y
	help
	  AV sync and play rate control management.

config AM_STREAMING
	bool "AMLOGIC AV Streaming support"
	default y
	select AM_PTSSERVER
	help
	  Driver for the AV streaming ports.

config AM_SUBTITLE
	bool	"AMLOGIC SubTitle support"
	default y
	help 
		Internal Sub Title support driver

endmenu
```

## drivers/amlogic/audiodsp/Kconfig
```kconfig
#
# audio dsp  configuration
#
menu "Amlogic audio dsp process "

config  AML_AUDIO_DSP
	tristate  "audio dsp control support "
	default y
	help  
		support the audio dsp ;
		

endmenu	
```

## drivers/amlogic/audiodsplog/Kconfig
```kconfig
#
# audio dsp  log configuration
#
menu "Amlogic audio dsp log"

config  AML_AUDIO_DSP_LOG
	tristate  "audio dsp log support "
	default y
	help  
		audio dsp log support ;
		

endmenu	
```

## drivers/amlogic/bluetooth/Kconfig
```kconfig
menu "Amlogic BT Device Support"

config BT_DEVICE
	bool "BT Device support"
	depends on BT && RFKILL
	select BACKLIGHT_CLASS_DEVICE
	default n
	help
	  Say Y here if you want to use the BT device.

config BCM4329_BT
    bool "BCM4329 bt support"
    depends on BT_DEVICE
    help
      Say y here if you want to use BCM4329 BT.

menuconfig SDIO_MARVELL_NH387_BT
	bool "Marvell nh387 bt support"
	depends on SD_MMC && SDIO_MARVELL_NH387_WIFI
	select BT_HCIBTSDIO
	select WEXT_SPY
	default n
		---help---
	  This module adds support for bt adapters based on
	  Marvell nh387 chipset.
if SDIO_MARVELL_NH387_BT		  
config MRVLNH387_PXA3XX_DMA_ALIGN
	depends on SDIO_MARVELL_NH387_BT
	bool "PXA3XX DMA alignment"
	default y
		---help---
	  PXA3XX DMA alignment.
endif	  
endmenu
```

## drivers/amlogic/camera/Kconfig
```kconfig
#
# AMLOGIC CAMERA DEVICE configuration
#

menu "Amlogic CAMERA Support"

#config CAMERA_OV2655
#	tristate "CAMERA OV2655 Driver"
#	default n
#	help
#		.MICRON 0.3M Bayer Sensor with AutoFocus
		
#config CAMERA_OV2665
#	tristate "CAMERA OV2665 Driver"
#	default n
#	help
#		.MICRON 2M Bayer Sensor with AutoFocus


config AMLOGIC_CAMERA_ENABLE
	tristate "AMLOGIC CAMERA Driver ENABLE"
	default n
	help
		MICRON 5M Bayer Sensor with AutoFocus
		
config AMLOGIC_SECOND_CAMERA_ENABLE
	depends on AMLOGIC_CAMERA_ENABLE
	bool "AMLOGIC SECOND CAMERA Driver ENABLE"
	default n
	help
		AMLOGIC SECOND CAMERA Driver ENABLE		
				
config CAMERA_OV5640
	tristate "CAMERA OV5640 Driver"
	default n
	depends on AMLOGIC_CAMERA_ENABLE
	help
		CAMERA_OV5640 support
		
config CAMERA_GC0308
	tristate "CAMERA GC0308 Driver"
	default n
	depends on AMLOGIC_CAMERA_ENABLE
	help
		GalaxyCore GC0308
		
config CAMERA_GT2005
	tristate "CAMERA GT2005 Driver"
	default n
	depends on AMLOGIC_CAMERA_ENABLE
	help
		GalaxyCore GT2005		
endmenu
```

## drivers/amlogic/canvas/Kconfig
```kconfig
#
# Canvas management driver configuration
#

menu "AMLOGIC Canvas management driver"

config AM_CANVAS
    bool "AMLOGIC Canvas management driver"
    default y
	help
	  Select to enable Canvas management driver.

endmenu
```

## drivers/amlogic/cardreader/Kconfig
```kconfig
#
# cardreader subsystem configuration
#

menu "Amlogic Card support"

config CARDREADER
	bool "Card reader support "
	default n

config SD_MMC
	bool "SD/MMC card driver support"
	default y
	depends on CARDREADER

config SDIO
	bool "sdio interface driver support"
	default y
	depends on CARDREADER
	select SD_MMC
	
config AM_ATA
	bool "ATA/ATAPI driver support"
	default n
	depends on CARDREADER

config CF
	bool "CF card driver support"
	default n
	depends on AM_ATA

config MS_MSPRO
	bool "MS/MSPRO card driver support"
	default n
	depends on CARDREADER

config XD
	bool "XD card driver support"
	default n
	depends on CARDREADER

config INAND
	bool "inand card driver support"
	default n
	depends on CARDREADER
	select SD_MMC
	
endmenu
```

## drivers/amlogic/cmem/Kconfig
```kconfig
#
# CMEM device configuration
#

menu "AMLOGIC Physical memory allocator"

config CMEM
    tristate "CMEM Physical memory allocator"
    default m
	help
	  Select to enable CMEM physical memory allocator driver.
endmenu
```

## drivers/amlogic/debug/Kconfig
```kconfig
#
# AMLOGIC tvin devices configuration
#

menu "Amlogic Linux Debug Support"

config AML_LINUX_DEBUG
	bool "Amlogic Linux Debug"
	default y
	help
		Amlogic Linux debug for register etc..

endmenu
```

## drivers/amlogic/deinterlace/Kconfig
```kconfig
#
# Deinterlace driver configuration
#

menu "AMLOGIC Deinterlace driver"

config DEINTERLACE
	tristate "DEINTERLACE driver"
	default n
	help
	  Select to enable AMLOGIC DEINTERLACE driver.
endmenu
```

## drivers/amlogic/demod/Kconfig
```kconfig
menu "AMLOGIC DEMOD Support"

menuconfig AM_DEMOD
	tristate "Amlogic demod driver"
	default n
	depends on AM_DVB
	help
		m1 internal Demod DVB-T/C suport

if AM_DEMOD

config AM_DEMOD_DEBUG
	bool "Amlogic Demod Debug Interface"
	default n
	depends on AM_DEMOD
	help
		m1 internal Demod debug interface

config AM_AMDEMOD_DVBC
	bool "AML DVBC demod driver"
	default n
	depends on AM_DEMOD
	help
		m1 internal Demod DVB-C Driver

config AM_AMDEMOD_DVBT
	bool "AML DVBT demod driver"
	default n
	depends on AM_DEMOD
	help
		m1 internal Demod DVB-T Driver

endif	# AM_DEMOD
		
endmenu
```

## drivers/amlogic/display/Kconfig
```kconfig
#
# Amlogic display driver configuration
#
menu "Amlogic Display Driver"

source "drivers/amlogic/display/vout/Kconfig"
source "drivers/amlogic/display/vout2/Kconfig"

source "drivers/amlogic/display/osd/Kconfig"
source "drivers/amlogic/display/backlight/Kconfig"
config  AM_GE2D
	tristate  "ge2d module"
	default y
	help 
		ge2d graphic  engine support

config  AM_LOGO
	bool  "setup logo"
	default n
	depends on FB_AM && AM_GE2D
	help 
		setup logo support osd parameter offered by Uboot 

endmenu	
```

## drivers/amlogic/display/backlight/Kconfig
```kconfig
menu "Amlogic Backlight Support"

config AMLOGIC_BACKLIGHT
	bool "Amlogic backlight support"
	select BACKLIGHT_CLASS_DEVICE
	default n
	help
	  Say Y here if you want to use the amlogic backlight management.

endmenu
```
