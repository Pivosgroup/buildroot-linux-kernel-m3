## drivers/amlogic/display/vout/Kconfig
```kconfig
#
# Video output configuration
#
menu "Amlogic video output module"

config AM_TV_OUTPUT
	tristate "TV output"
	default y
	help  
		tv output module

config AM_TCON_OUTPUT
	tristate "LCD output" 
	help  
		LCD output module

choice
    prompt "LCD Output I/F Type"
    depends on AM_TCON_OUTPUT
    help
        For TFT LCD panels, there are three interfaces: RGB TTL I/F for Traditional panels, LVDS I/F for for New high resolution panels, and MiniLVDS I/F for special panels.
        Our early chips only support RGB TTL I/F. From M3 chips, also support LVDS and MiniLVDS I/F.

config AM_LCD_TTL_OUTPUT
    bool "RGB TTL Interface"
    help
        LCD output module, RGB TTL Interface, for Tranditional lcd panels

config AM_LCD_LVDS_OUTPUT
    bool "LVDS Interface"
    help        
        LCD output module, Internal LVDS Interface, for new high resolution panels

config AM_LCD_MLVDS_OUTPUT
    bool "miniLVDS Interface"
    help        
        LCD output module, Internal miniLVDS Interface, for special panels
endchoice

config AML_TCON_W7NEW
	tristate "W7NEW panel driver"
	depends on  AM_LCD_TTL_OUTPUT
	help  
		W7NEW LCD panel module

config AML_TCON_W8
	tristate "W8 panel driver"
	depends on  AM_LCD_TTL_OUTPUT
	help  
		W8 LCD panel module

config AML_TCON_Y7
	tristate "Y7 panel driver"
	depends on  AM_LCD_TTL_OUTPUT
	help  
		Y7 LCD panel module
		
config AML_TCON_S7
	tristate "S7 panel driver"
	depends on  AM_LCD_TTL_OUTPUT
	help  
		S7 LCD panel module			

config AML_LVDS_R_AT070TNA2
	tristate "R_AT070TNA2"
	depends on AM_LCD_LVDS_OUTPUT
	help
		AT070TNA2 LVDS panel.
		
config AML_LVDS_HV070WSA_100
  tristate "HV070WSA_100"
  depends on AM_LCD_LVDS_OUTPUT
  help
	  HV070WSA_100 LVDS panel.
	  
config AML_LVDS_G_TM081JF01
  tristate "G_TM081JF01"
  depends on AM_LCD_LVDS_OUTPUT
  help
	  G_TM081JF01 LVDS panel.


config AML_MLVDS_A_TM080XDH		
	tristate "A_TM080XDH"
	depends on AM_LCD_MLVDS_OUTPUT
	help
		TM080XDH miniLVDS panel.

config AML_LVDS_G_W13		
	tristate "W13"
	depends on AM_LCD_LVDS_OUTPUT
	help
		W13 LVDS panel.
		
config AML_MLVDS_G_TM080XDH		
	tristate "G_TM080XDH"
	depends on AM_LCD_MLVDS_OUTPUT
	help
		TM080XDH miniLVDS panel.
		
config AML_MLVDS_G_TM080XDH2D		
	tristate "G_TM080XDH_2D"
	depends on AM_LCD_MLVDS_OUTPUT
	help
		TM080XDH_2D miniLVDS panel.
		
endmenu
	
```

## drivers/amlogic/dvb/Kconfig
```kconfig
#
# Smart card driver configuration
#

menu "AMLOGIC DVB driver"

config AM_DVB
	tristate "AMLOGIC DVB driver"
	default n
	depends on DVB_CORE
	help
		Select to enable AMLogic DVB driver.

config AMLOGIC_S_TS0
	bool "Serial TS0"
	default n
	depends on AM_DVB
	help
		TS0 in serial mode.

config AMLOGIC_S_TS1
	bool "Serial TS1"
	default n
	depends on AM_DVB
	help
		TS1 in serial mode.

config AMLOGIC_S_TS2
	bool "Serial TS2"
	default n
	depends on AM_DVB
	help
		TS0 in serial mode.

config AM_GX1001
	tristate "GX1001 demod driver"
	default n
	depends on AM_DVB
	help
		Select to enable GX1001 demod driver.
		
config AM_MXL101
	tristate "MXL101 demod driver"
	default n
	depends on AM_DVB
	help
		Select to enable MXL101 demod driver.
		
config AM_AVL6211
	tristate "AVL6211 demod driver"
	default n
	depends on AM_DVB
	help
		Select to enable AVL6211 demod driver.		
		
config AM_ITE9173
	tristate "ITE9173 demod driver"
	default n
	depends on AM_DVB
	help
		Select to enable ITE9173 demod driver.	

endmenu
```

## drivers/amlogic/dvb/dib7090/Kconfig
```kconfig
#
# Dib7090 driver configuration
#

menuconfig AM_DIB7090P
	bool "DiB7090P demod driver"
       depends on AM_DVB
	default n
        help
        	Select to enable DiB7090P demod driver.

if AM_DIB7090P

config DIB7090_OUTPUT_SERIAL
	bool "Serial Output Mode"
	depends on AM_DIB7090P
	default n
	help
	 data default on DATA7

endif
```

## drivers/amlogic/efuse/Kconfig
```kconfig
#
# Amlogic efuse device configuration
#

menu "Amlogic EFUSE Support"

config EFUSE
        tristate "EFUSE Driver"
        default m
        help
         	EFUSE device driver.

endmenu
```

## drivers/amlogic/extern_io/Kconfig
```kconfig
menu "Extern IO Support"


config TCA6424
	bool "TCA6424 extern io support"
	depends on I2C_AML
	default n
	---help---
	  This module adds support for tca6424 extern io

config SN7325
	bool "SN7325 extern io support"
	depends on I2C_AML
	default n
	---help---
	  This module adds support for sn7325 extern io

endmenu
```

## drivers/amlogic/freescale/Kconfig
```kconfig
#
# Post Process Manager device configuration
#

menu "AMLOGIC free scale driver"

config FREE_SCALE
    tristate "AMLOGIC free scale driver"
    default n
	help
	  Select to enable AMLOGIC free scale driver.
config MIX_FREE_SCALE
    tristate "AMLOGIC mix free scale"
    depends on  FREE_SCALE
    default n
	help
	  Select mix free scale mode.
endmenu
```
