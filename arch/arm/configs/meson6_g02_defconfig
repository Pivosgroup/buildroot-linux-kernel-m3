## arch/arm/configs/meson6_g02_defconfig
```kconfig
CONFIG_EXPERIMENTAL=y
# CONFIG_LOCALVERSION_AUTO is not set
# CONFIG_SWAP is not set
CONFIG_SYSVIPC=y
CONFIG_BSD_PROCESS_ACCT=y
CONFIG_RCU_TRACE=y
CONFIG_LOG_BUF_SHIFT=17
CONFIG_CGROUPS=y
CONFIG_CGROUP_FREEZER=y
CONFIG_CGROUP_CPUACCT=y
CONFIG_RESOURCE_COUNTERS=y
CONFIG_CGROUP_SCHED=y
# CONFIG_FAIR_GROUP_SCHED is not set
CONFIG_RT_GROUP_SCHED=y
CONFIG_BLK_DEV_INITRD=y
CONFIG_INITRAMFS_SOURCE="../out/target/product/g02ref/root"
CONFIG_ASHMEM=y
# CONFIG_AIO is not set
CONFIG_EMBEDDED=y
# CONFIG_VM_EVENT_COUNTERS is not set
CONFIG_MODULES=y
CONFIG_MODULE_UNLOAD=y
CONFIG_BLOCK=y
CONFIG_LBDAF=y
# CONFIG_BLK_DEV_BSG is not set
CONFIG_BLK_DEV_INTEGRITY=y
# CONFIG_IOSCHED_CFQ is not set
CONFIG_ARCH_MESON6=y
CONFIG_MESON_SUSPEND=y
CONFIG_MESON_LEGACY_REGISTER_API=y
CONFIG_MESON_CUSTOM_BOARD_SUPPORT=y
# CONFIG_MACH_MESON6_SKT is not set
# CONFIG_MACH_MESON6_REF is not set
# CONFIG_MACH_MESON6_G04 is not set
CONFIG_MACH_MESON6_G02=y
CONFIG_MISC_DEVICES=y
CONFIG_MESON_INPUT_TOUCHSCREEN=y
CONFIG_ARM_ERRATA_751472=y
CONFIG_ARM_ERRATA_753970=y
CONFIG_ARM_ERRATA_754322=y
CONFIG_ARM_ERRATA_764369=y
CONFIG_NO_HZ=y
CONFIG_HIGH_RES_TIMERS=y
CONFIG_SMP=y
CONFIG_NR_CPUS=2
CONFIG_PREEMPT=y
CONFIG_AEABI=y
CONFIG_HIGHMEM=y
CONFIG_CPU_FREQ=y
CONFIG_CPU_FREQ_GOV_ONDEMAND=y
CONFIG_CPU_FREQ_GOV_CONSERVATIVE=y
CONFIG_CPU_IDLE=y
CONFIG_VFP=y
CONFIG_NEON=y
CONFIG_BINFMT_MISC=y
CONFIG_WAKELOCK=y
CONFIG_NET=y
CONFIG_PACKET=y
CONFIG_UNIX=y
CONFIG_NET_KEY=y
CONFIG_INET=y
CONFIG_IP_ADVANCED_ROUTER=y
CONFIG_IP_MULTIPLE_TABLES=y
CONFIG_INET_ESP=y
# CONFIG_INET_XFRM_MODE_BEET is not set
# CONFIG_INET_LRO is not set
CONFIG_IPV6=y
CONFIG_IPV6_PRIVACY=y
CONFIG_IPV6_ROUTER_PREF=y
CONFIG_IPV6_OPTIMISTIC_DAD=y
CONFIG_INET6_AH=y
CONFIG_INET6_ESP=y
CONFIG_INET6_IPCOMP=y
CONFIG_IPV6_MIP6=y
CONFIG_IPV6_TUNNEL=y
CONFIG_IPV6_MULTIPLE_TABLES=y
CONFIG_NETFILTER=y
CONFIG_NF_CONNTRACK=y
CONFIG_NF_CONNTRACK_EVENTS=y
CONFIG_NF_CT_PROTO_DCCP=y
CONFIG_NF_CT_PROTO_SCTP=y
CONFIG_NF_CT_PROTO_UDPLITE=y
CONFIG_NF_CONNTRACK_AMANDA=y
CONFIG_NF_CONNTRACK_FTP=y
CONFIG_NF_CONNTRACK_H323=y
CONFIG_NF_CONNTRACK_IRC=y
CONFIG_NF_CONNTRACK_NETBIOS_NS=y
CONFIG_NF_CONNTRACK_PPTP=y
CONFIG_NF_CONNTRACK_SANE=y
CONFIG_NF_CONNTRACK_TFTP=y
CONFIG_NF_CT_NETLINK=y
CONFIG_NETFILTER_TPROXY=y
CONFIG_NETFILTER_XT_TARGET_CLASSIFY=y
CONFIG_NETFILTER_XT_TARGET_CONNMARK=y
CONFIG_NETFILTER_XT_TARGET_MARK=y
CONFIG_NETFILTER_XT_TARGET_NFLOG=y
CONFIG_NETFILTER_XT_TARGET_NFQUEUE=y
CONFIG_NETFILTER_XT_TARGET_TPROXY=y
CONFIG_NETFILTER_XT_TARGET_TRACE=y
CONFIG_NETFILTER_XT_MATCH_COMMENT=y
CONFIG_NETFILTER_XT_MATCH_CONNBYTES=y
CONFIG_NETFILTER_XT_MATCH_CONNLIMIT=y
CONFIG_NETFILTER_XT_MATCH_CONNMARK=y
CONFIG_NETFILTER_XT_MATCH_CONNTRACK=y
CONFIG_NETFILTER_XT_MATCH_HASHLIMIT=y
CONFIG_NETFILTER_XT_MATCH_HELPER=y
CONFIG_NETFILTER_XT_MATCH_IPRANGE=y
CONFIG_NETFILTER_XT_MATCH_LENGTH=y
CONFIG_NETFILTER_XT_MATCH_LIMIT=y
CONFIG_NETFILTER_XT_MATCH_MAC=y
CONFIG_NETFILTER_XT_MATCH_MARK=y
CONFIG_NETFILTER_XT_MATCH_POLICY=y
CONFIG_NETFILTER_XT_MATCH_PKTTYPE=y
CONFIG_NETFILTER_XT_MATCH_QTAGUID=y
CONFIG_NETFILTER_XT_MATCH_QUOTA=y
CONFIG_NETFILTER_XT_MATCH_QUOTA2=y
CONFIG_NETFILTER_XT_MATCH_QUOTA2_LOG=y
CONFIG_NETFILTER_XT_MATCH_SOCKET=y
CONFIG_NETFILTER_XT_MATCH_STATE=y
CONFIG_NETFILTER_XT_MATCH_STATISTIC=y
CONFIG_NETFILTER_XT_MATCH_STRING=y
CONFIG_NETFILTER_XT_MATCH_TIME=y
CONFIG_NETFILTER_XT_MATCH_U32=y
CONFIG_NF_CONNTRACK_IPV4=y
CONFIG_IP_NF_IPTABLES=y
CONFIG_IP_NF_MATCH_AH=y
CONFIG_IP_NF_MATCH_ECN=y
CONFIG_IP_NF_MATCH_TTL=y
CONFIG_IP_NF_FILTER=y
CONFIG_IP_NF_TARGET_REJECT=y
CONFIG_IP_NF_TARGET_REJECT_SKERR=y
CONFIG_IP_NF_TARGET_LOG=y
CONFIG_NF_NAT=y
CONFIG_IP_NF_TARGET_MASQUERADE=y
CONFIG_IP_NF_TARGET_NETMAP=y
CONFIG_IP_NF_TARGET_REDIRECT=y
CONFIG_IP_NF_MANGLE=y
CONFIG_IP_NF_RAW=y
CONFIG_IP_NF_ARPTABLES=y
CONFIG_IP_NF_ARPFILTER=y
CONFIG_IP_NF_ARP_MANGLE=y
CONFIG_NF_CONNTRACK_IPV6=y
CONFIG_IP6_NF_IPTABLES=y
CONFIG_IP6_NF_TARGET_LOG=y
CONFIG_IP6_NF_FILTER=y
CONFIG_IP6_NF_TARGET_REJECT=y
CONFIG_IP6_NF_TARGET_REJECT_SKERR=y
CONFIG_IP6_NF_MANGLE=y
CONFIG_IP6_NF_RAW=y
CONFIG_BRIDGE=y
# CONFIG_BRIDGE_IGMP_SNOOPING is not set
CONFIG_PHONET=y
CONFIG_NET_SCHED=y
CONFIG_NET_SCH_HTB=y
CONFIG_NET_SCH_INGRESS=y
CONFIG_NET_CLS_U32=y
CONFIG_NET_EMATCH=y
CONFIG_NET_EMATCH_U32=y
CONFIG_NET_CLS_ACT=y
CONFIG_NET_ACT_POLICE=y
CONFIG_NET_ACT_GACT=y
CONFIG_NET_ACT_MIRRED=y
CONFIG_CFG80211=y
CONFIG_MAC80211=y
CONFIG_I2C_AML=y
CONFIG_SARADC_AM=y
CONFIG_AM_REMOTE=y
CONFIG_ADC_KEYPADS_AM=y
CONFIG_KEY_INPUT_CUSTOM_AM=y
CONFIG_GOODIX_GT82X_CAPACITIVE_TOUCHSCREEN=y
CONFIG_EFUSE=y
CONFIG_AM_SENSORS=y
CONFIG_MPU3050=y
CONFIG_MPU_SENSORS_MPU3050=y
CONFIG_MPU_SENSORS_BMA222=y
CONFIG_MPU_SENSORS_MMC328X=y
CONFIG_MPU_SENSORS_TIMERIRQ=y
CONFIG_USB_DWC_OTG_HCD=y
# CONFIG_USB_HOST_ELECT_TEST is not set
CONFIG_CARDREADER=y
# CONFIG_MMC_AML is not set
CONFIG_AMLOGIC_SPI_NOR=y
CONFIG_AM_NAND=y
CONFIG_AML_NFTL=y
CONFIG_AM_ETHERNET=y
CONFIG_AM_ETHERNET_DEBUG_LEVEL=1
CONFIG_AM_WIFI=y
CONFIG_AM_WIFI_USB=y
CONFIG_RTL8XXX_CU_USB_WIFI=m

CONFIG_AM_TV_OUTPUT=y
# CONFIG_AM_LCD_OUTPUT is not set
CONFIG_AM_VIDEO=y
CONFIG_FB_AM=y
CONFIG_FB_OSD2_CURSOR=y
CONFIG_FB_OSD2_DEFAULT_WIDTH=32
CONFIG_FB_OSD2_DEFAULT_HEIGHT=32
CONFIG_FB_OSD2_DEFAULT_WIDTH_VIRTUAL=32
CONFIG_FB_OSD2_DEFAULT_HEIGHT_VIRTUAL=32
CONFIG_FB_OSD1_DEFAULT_BITS_PER_PIXEL=32
CONFIG_FB_OSD1_DEFAULT_WIDTH=1280
CONFIG_FB_OSD1_DEFAULT_HEIGHT=720
CONFIG_FB_OSD1_DEFAULT_WIDTH_VIRTUAL=1280
CONFIG_FB_OSD1_DEFAULT_HEIGHT_VIRTUAL=1440
CONFIG_AMLOGIC_BACKLIGHT=y
CONFIG_AM_GE2D=y
CONFIG_POST_PROCESS_MANAGER=y
CONFIG_POST_PROCESS_MANAGER_PPSCALER=y
CONFIG_VIDEO_AMLOGIC_CAPTURE=y
CONFIG_VIDEO_AMLOGIC_CAPTURE_PROBE=y
CONFIG_VIDEO_AMLOGIC_CAPTURE_GT2005=y
CONFIG_VIDEO_AMLOGIC_CAPTURE_GC0308=y
CONFIG_UEVENT_HELPER_PATH="/sbin/mdev"
CONFIG_DEVTMPFS=y
CONFIG_DEVTMPFS_MOUNT=y
CONFIG_MTD_UBI=y
CONFIG_BLK_DEV_LOOP=y
CONFIG_UID_STAT=y
CONFIG_SCSI=y
CONFIG_BLK_DEV_SD=y
CONFIG_MD=y
CONFIG_BLK_DEV_DM=y
CONFIG_DM_DEBUG=y
CONFIG_DM_CRYPT=y
CONFIG_DM_UEVENT=y
CONFIG_NETDEVICES=y
CONFIG_USB_USBNET=y
CONFIG_PPP=y
CONFIG_PPP_MULTILINK=y
CONFIG_PPP_FILTER=y
CONFIG_PPP_ASYNC=y
CONFIG_PPP_SYNC_TTY=y
CONFIG_PPP_DEFLATE=y
CONFIG_PPP_BSDCOMP=y
CONFIG_PPP_MPPE=y
CONFIG_PPPOLAC=y
CONFIG_PPPOPNS=y
CONFIG_INPUT_EVDEV=y
CONFIG_DEVPTS_MULTIPLE_INSTANCES=y
CONFIG_TTY_PRINTK=y
CONFIG_HVC_DCC=y
CONFIG_SPI=y
CONFIG_SPI_MASTER=y
CONFIG_SPI_BITBANG=y
CONFIG_SPI_GPIO=y
CONFIG_SPI_SPIDEV=y
CONFIG_POWER_SUPPLY=y
# CONFIG_MFD_SUPPORT is not set
CONFIG_BACKLIGHT_LCD_SUPPORT=y
CONFIG_SND_AML_M6_RT5631=y
CONFIG_SND_AML_M_DUMMY_CODEC=y
CONFIG_USB_DEVICEFS=y
CONFIG_USB_ACM=y
CONFIG_USB_STORAGE=y
CONFIG_USB_SERIAL=y
CONFIG_USB_SERIAL_OPTION=y
CONFIG_USB_GADGET=y
CONFIG_USB_GADGET_DWC_OTG=y
CONFIG_USB_G_ANDROID=y
CONFIG_UIO=y
CONFIG_UIO_PDRV=y
CONFIG_STAGING=y
CONFIG_ANDROID=y
CONFIG_ANDROID_BINDER_IPC=y
CONFIG_ANDROID_LOGGER=y
CONFIG_ANDROID_LOW_MEMORY_KILLER=y
CONFIG_EXT2_FS=y
CONFIG_EXT3_FS=y
CONFIG_EXT3_FS_POSIX_ACL=y
CONFIG_EXT3_FS_SECURITY=y
CONFIG_FUSE_FS=y
CONFIG_ISO9660_FS=y
CONFIG_JOLIET=y
CONFIG_ZISOFS=y
CONFIG_UDF_FS=y
CONFIG_MSDOS_FS=y
CONFIG_VFAT_FS=y
CONFIG_NTFS_FS=y
CONFIG_TMPFS=y
CONFIG_HFSPLUS_FS=y
CONFIG_YAFFS_FS=y
CONFIG_YAFFS_DISABLE_TAGS_ECC=y
CONFIG_YAFFS_DISABLE_BLOCK_REFRESHING=y
CONFIG_YAFFS_DISABLE_BACKGROUND=y
CONFIG_UBIFS_FS=y
CONFIG_NLS_CODEPAGE_437=y
CONFIG_NLS_CODEPAGE_936=y
CONFIG_NLS_CODEPAGE_950=y
CONFIG_NLS_ISO8859_1=y
CONFIG_PRINTK_TIME=y
CONFIG_DEBUG_KERNEL=y
# CONFIG_SCHED_DEBUG is not set
CONFIG_TIMER_STATS=y
CONFIG_DEBUG_INFO=y
CONFIG_SECURITYFS=y
CONFIG_CRYPTO_XTS=y
CONFIG_CRYPTO_SHA512=y
CONFIG_CRYPTO_WP512=y
CONFIG_CRYPTO_TWOFISH=y
CONFIG_CRC_T10DIF=y
CONFIG_XZ_DEC=y
CONFIG_V4L_USB_DRIVERS=y
CONFIG_USB_VIDEO_CLASS=y
CONFIG_USB_VIDEO_CLASS_INPUT_EVDEV=y
CONFIG_USB_PWC=m
CONFIG_USB_PWC_INPUT_EVDEV=y
```

## arch/arm/mach-meson/Kconfig
```kconfig
menu "Meson platform type"
	depends on ARCH_MESON

config MACH_MESON_6236M
	select GENERIC_ALLOCATOR
	bool "Support M1 6236(MODE:MBOX728) platform(machid=2951)"
	help
	  Include support for the AMLOGIC M1 6236M Emulation Baseboard platform.

config MACH_MESON_8626M_REFC02
	select GENERIC_ALLOCATOR
	bool "Support M1 8626(MBOX_8626M1_V1.0) platform(machid=2952)"
	help
	  Include support for the AMLOGIC M1 8626M Emulation Baseboard platform.

config MACH_MESON_6236M_SH
	select GENERIC_ALLOCATOR
	bool "Support M1 6236(dpf_aml6236-m_innolux8_skt_v1) platform(machid=2953)"
	help
	  Include support for the AMLOGIC M1 6236M Emulation Baseboard platform.

config MACH_MESON_8626M_SH
	select GENERIC_ALLOCATOR
	bool "Support M1 8626(mbx_aml8626-m_skt_v1) platform(machid=2954)"
	help
	  Include support for the AMLOGIC M1 8626M Emulation Baseboard platform.

config MACH_MESON_8226M
	select GENERIC_ALLOCATOR
	bool "Support M1 8226(dvbc_8226m1_v1.0) platform(machid=2955)"
	help
	  Include support for the AMLOGIC M1 8226M Emulation Baseboard platform.

config MACH_MESON_8726M_REFA00
	select GENERIC_ALLOCATOR
	bool "Support M1 8726(mid_8726m1_v1.0) platform(machid=2956)"
	help
	  Include support for the AMLOGIC M1 8726M Emulation Baseboard platform.

config MACH_MESON_8726M_REFC01
	select GENERIC_ALLOCATOR
	bool "Support M1 8726(Meson Board_AML8726-M) platform(machid=2956)"
	help
	  Include support for the AMLOGIC M1 8726M Emulation Baseboard platform.

config MACH_MESON_8726M_REFC03
	select GENERIC_ALLOCATOR
	bool "Support M1 8726(DVBC_8726M1_V1.0) platform(machid=2957)"
	help
	  Include support for the AMLOGIC M1 8726M DVBC Emulation Baseboard platform.

config MACH_MESON_8726M_REFC06
	select GENERIC_ALLOCATOR
	bool "Support M1 8726(Giec) platform(machid=2957)"
	help
	  Include support for the AMLOGIC M1 8726M Giec Baseboard platform.
	  
config MACH_MESON_8726M_REFB05
	select GENERIC_ALLOCATOR
	bool "Support M1 8726(ML) platform(machid=2956)"
	help
	  Include support for the AMLOGIC M1 8726M Emulation Baseboard platform.
	  
config MACH_MESON_8726M_REFB06
	select GENERIC_ALLOCATOR
	bool "Support M1 8726(MlMBX) platform(machid=2956)"
	help
	  Include support for the AMLOGIC M1 8726M Emulation Baseboard platform.

config MACH_MESON_8726M_REFB02
	select GENERIC_ALLOCATOR
	bool "Support M1 8726(W10) platform(machid=2956)"
	help
	  Include support for the AMLOGIC M1 8726M Emulation Baseboard platform.

config MACH_MESON_8726M_REFB01
	select GENERIC_ALLOCATOR
	bool "Support M1 8726(W7) platform(machid=2956)"
	help
	  Include support for the AMLOGIC M1 8726M Emulation Baseboard platform.

config MACH_MESON_8726M_REFB08
	select GENERIC_ALLOCATOR
	bool "Support M1 8726(W8) platform(machid=2956)"
	help
	  Include support for the AMLOGIC M1 8726M Emulation Baseboard platform.

config MACH_MESON_8726M_REFB09
	select GENERIC_ALLOCATOR
	bool "Support M1 8726(P7new) platform(machid=2956)"
	help
	  Include support for the AMLOGIC M1 8726M Emulation Baseboard platform.

config MACH_MESON_8726M_REFB03
	select GENERIC_ALLOCATOR
	bool "Support M1 8726(K7) platform(machid=2956)"
	help
	  Include support for the AMLOGIC M1 8726M Emulation Baseboard platform.
	  
config MACH_MESON_8726M_REFB07
	select GENERIC_ALLOCATOR
	bool "Support M1 8726(C7) platform(machid=2956)"
	help
	  Include support for the AMLOGIC M1 8726M Emulation Baseboard platform.
	  
config MACH_MESON_8726M_REFB04
	select GENERIC_ALLOCATOR
	bool "Support M1 8726(K8) platform(machid=2956)"
	help
	  Include support for the AMLOGIC M1 8726M Emulation Baseboard platform.  

config MACH_MESON_8726M_REFC05
        select GENERIC_ALLOCATOR
        bool "Support M1 8726(Skyworth) platform(machid=2957)"
        help
          Include support for the AMLOGIC M1 8726M Skyworth platform.

config MACH_MESON_8726M_REFC04
        select GENERIC_ALLOCATOR
        bool "Support M1 8726(Hisense) platform(machid=2957)"
        help
          Include support for the AMLOGIC M1 8726M Hisense platform.

config MACH_MESON_8726M_REFC08
        select GENERIC_ALLOCATOR
        bool "Support M1 8726(refc08) platform(machid=2957)"
        help
          Include support for the AMLOGIC M1 8726M refc08 platform.
 
config MACH_MESON_8726M_REFB10
	select GENERIC_ALLOCATOR
	bool "Support M1 8726(G7) platform(machid=2956)"
	help
	  Include support for the AMLOGIC M1 8726M Emulation Baseboard platform.

config MACH_MESON_8726M_REFB11
	select GENERIC_ALLOCATOR
	bool "Support M1 8726(B11) platform(machid=2956)"
	help
	  Include support for the AMLOGIC M1 8726M Emulation Baseboard platform.
	  	  
config MACH_MESON_8726M_REFB12
	select GENERIC_ALLOCATOR
	bool "Support M1 8726(r10) platform(machid=2956)"
	help
	  Include support for the AMLOGIC M1 8726M Emulation Baseboard platform.

config MACH_MESON_8726M_REFB13
	select GENERIC_ALLOCATOR
	bool "Support M1 8726(refb13) platform(machid=2956)"
	help
	  Include support for the AMLOGIC M1 8726M Emulation Baseboard platform.
	  
config MACH_MESON_8726M_REFB17
	select GENERIC_ALLOCATOR
	bool "Support M1 8726(REFB17) platform(machid=2956)"
	help
	  Include support for the AMLOGIC M1 8726M Emulation Baseboard platform.

config MACH_MESON_8726M_REFB18
	select GENERIC_ALLOCATOR
	bool "Support M1 8726(P10) platform(machid=2956)"
	help
	  Include support for the AMLOGIC M1 8726M Emulation Baseboard platform.

config MACH_MESON_8726M_REFB19
	select GENERIC_ALLOCATOR
	bool "Support M1 8726(REFB19) platform(machid=2956)"
	help
	  Include support for the AMLOGIC M1 8726M Emulation Baseboard platform.
	  	  
config MACH_MESON_8726M_REFB14
	select GENERIC_ALLOCATOR
	bool "Support M1 8726(refb14) platform(machid=2956)"
	help
	  Include support for the AMLOGIC M1 8726M Emulation Baseboard platform.
	  
config MACH_MESON_8726M_REFB16
	select GENERIC_ALLOCATOR
	bool "Support M1 8726(refb16) platform(machid=2956)"
	help
	  Include support for the AMLOGIC M1 8726M Emulation Baseboard platform.	  
	  	  
config MESON_CLOCK_TICK_RATE
    int "Clock Tick Rate"
	default 25000000

endmenu
```
