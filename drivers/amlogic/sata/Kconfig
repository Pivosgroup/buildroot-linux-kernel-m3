## drivers/amlogic/sata/Kconfig
```kconfig
menu "Amlogic SATA Support"

if !ATA
comment "Need config 'Serial ATA and Parallel ATA drivers'"
endif
config SATA_DWC_AHCI
        bool "Amloigc SATA AHCI support"
				depends on ATA
        help
           depend on libATA


endmenu
```

## drivers/amlogic/security/Kconfig
```kconfig
menu 	"Amlogic IPTV Security Support"
config  AM_IPTV_SECURITY
	tristate  "iptv security support"
	default n
	help 
		iptv security support
endmenu
```

## drivers/amlogic/smartcard/Kconfig
```kconfig
#
# Smart card driver configuration
#

menu "AMLOGIC Smart card driver"

config AM_SMARTCARD
	tristate "AMLOGIC Smart card driver"
	default n
	help
		Select to enable Smart card driver.
endmenu
```

## drivers/amlogic/tvin/Kconfig
```kconfig
#
# AMLOGIC tvin devices configuration
#

menu "Amlogic TVIN Support"

config TVIN_MPEG
	bool "Amlogic TVIN MPEGIN device"
	default n
	help
		MPEG device driver.

config TVIN_HDMI
	bool "Amlogic TVIN HDMIRX device"
	default n
	help
		HDMI device driver.

config TVIN_BT656IN
	bool "Amlogic TVIN BT656IN device"
	default n
	help
		BT656IN device driver.

config TVIN_DVIN
	bool "Amlogic TVIN DVIN device"
	default n
	help
		DVIN device driver.

config TVIN_AFE
	bool "Amlogic TVIN TVAFE device"
	default n
	depends on ARCH_MESON2
	help
		AFE device driver.

config TVIN_VIUIN
	bool "Amlogic TVIN VIUIN device"
	default n
	help
		VIUIN device driver.

config TVIN_VDIN
	bool "Amlogic TVIN VDIN device"
	default n
	help
		VDIN devices driver.

source "drivers/amlogic/tvin/tuners/Kconfig"

endmenu
```

## drivers/amlogic/tvin/tuners/Kconfig
```kconfig
#
# AMLOGIC tvin devices configuration
#

menu "Amlogic TVIN Tuner Support"

config TVIN_TUNER
	bool "Amlogic TVIN Tuner Core"
	default n
	help
		TVIN Tuner Bridge Driver.

config TVIN_TUNER_FQ1216ME
	bool "Philips FQ1216ME Tuner Device Support"
	default n
	select TVIN_TUNER
	help
		PHILIPS FQ1216ME tuner driver.

endmenu
```

## drivers/amlogic/uart/Kconfig
```kconfig
choice
        prompt "Amlogic UART Support"
        default AM_UART_WITH_S_CORE

config AM_UART_WITH_S_CORE
        bool "with serial core"
        depends on AMLOGIC_SERIES
        select SERIAL_CORE
        select SERIAL_CORE_CONSOLE
        help
           hardware uart

config AM_UART_WITHOUT_S_CORE
        bool "without serial core"
        depends on AMLOGIC_SERIES
        select SERIAL_CORE
        select SERIAL_CORE_CONSOLE
        help
           hardware uart

endchoice

choice
        prompt "---SET ttyS0 for CONSOLE PORT"
        default AM_UART0_SET_PORT_A

config AM_UART0_SET_PORT_AO
        bool "uart port AO"
        depends on ARCH_MESON3
        select SERIAL_CORE
        select SERIAL_CORE_CONSOLE
        help
           hardware uart

config AM_UART0_SET_PORT_A
        bool "uart port A"
        depends on AMLOGIC_SERIES
        select SERIAL_CORE
        select SERIAL_CORE_CONSOLE
        help
           hardware uart

config AM_UART0_SET_PORT_B
        bool "uart port B"
        depends on AMLOGIC_SERIES
        select SERIAL_CORE
        select SERIAL_CORE_CONSOLE
        help
           hardware uart

config AM_UART0_SET_PORT_C
        bool "uart port C"
        depends on ARCH_MESON3
        select SERIAL_CORE
        select SERIAL_CORE_CONSOLE
        help
           hardware uart

endchoice

menu  "---SET ttyS1 support"
     depends on AM_UART_WITHOUT_S_CORE
 
config UART_USE_FIQ
        bool "UART1 use FIQ for high speed"     
        depends on AMLOGIC_SERIES
        select SERIAL_CORE
        select SERIAL_CORE_CONSOLE
        default n
        help
           hardware uart

endmenu
```

## drivers/amlogic/ump/Kconfig
```kconfig
#
# Mali 400 GPU OpenGL device driver
#

menu "Mali 400 UMP device driver"

config UMP
	tristate "Mali 400 UMP device driver"
	depends on m
	default m
	help
	  Enable kernel module build for Mali 400 Unified Memory Provider device driver.

endmenu
```

## drivers/amlogic/usb/Kconfig
```kconfig
menu "Amlogic USB Support"

config USB_DWC_OTG_HCD
        bool "Amloigc usb host controler dwc_otg support"

        help
           usb dwc_otg

config USB_HOST_ELECT_TEST
				bool "USB High speed electric test support"
				depends on USB_DWC_OTG_HCD
				default y
				help
					Enable this config to support USB High speed electric test.

config USB_PHY_CONTROL
				bool "Amlogic usb controller power/clock/tuning control"
				default y
				help
					[y]Enalbe this config to use additional function that
						 control amlogic usb controller's power, clock, tuning and others..
					[n]Disable this config to disable this function.
endmenu
```

## drivers/amlogic/watchdog/Kconfig
```kconfig
#
# AMLOGIC Watchdog
#

menu "Amlogic Watchdog Timer Support"

config AML_WATCHDOG
	tristate "Amlogic Watchdog"
	default y
	help
		Amlogic watchdog timer embedded in chip.
endmenu
```
