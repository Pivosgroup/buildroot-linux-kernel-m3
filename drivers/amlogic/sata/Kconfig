## drivers/media/video/amlcamera/Kconfig
```kconfig
config AMLOGIC_CAPTURE_FRAME_ROTATE
	bool "Enable function to support frame rotation"
	depends on VIDEO_AMLOGIC_CAPTURE
	default n
	---help---
          It will support frame rotation when enable this config

config AMLOGIC_VM_DISABLE_VIDEOLAYER
	bool "Force disable Videolayer when use vm"
	depends on VIDEO_AMLOGIC_CAPTURE
	default n
	---help---
          It will disable amvideo provider when enable this config

config VIDEO_AMLOGIC_CAPTURE_PROBE
	bool "Force check wether camera devices exist"
	depends on VIDEO_AMLOGIC_CAPTURE
	default n
	---help---
	  Probe wether the camera devices exist by trying to read its 
	  i2c port. It may cost some time, say Y here if you want it.
config VIDEO_AMLOGIC_FLASHLIGHT
	tristate "Amlogic Platform Flashlight Driver"
	depends on VIDEO_AMLOGIC_CAPTURE
	default n
	---help---
	  Amlogic flashlight driver.
	  Say Y here if you want this driver.
config VIDEO_AMLOGIC_CAPTURE_GT2005
	tristate "Amlogic Platform Capture Driver for GT2005"
	depends on VIDEO_AMLOGIC_CAPTURE
	select VIDEOBUF_VMALLOC
	select TVIN_BT656IN
	select TVIN_VDIN
	default n
	---help---
	  Amlogic capture driver.
	  Say Y here if you want this driver.

config VIDEO_AMLOGIC_CAPTURE_GC0308
	tristate "Amlogic Platform Capture Driver for GC0308"
	depends on VIDEO_AMLOGIC_CAPTURE
	select VIDEOBUF_VMALLOC
	select TVIN_BT656IN
	select TVIN_VDIN
	default n
	---help---
	  Amlogic capture driver.
	  Say Y here if you want this driver.

config VIDEO_AMLOGIC_CAPTURE_GC0329
	tristate "Amlogic Platform Capture Driver for GC0329"
	depends on VIDEO_AMLOGIC_CAPTURE
	select VIDEOBUF_VMALLOC
	select TVIN_BT656IN
	select TVIN_VDIN
	default n
	---help---
	  Amlogic capture driver.
	  Say Y here if you want this driver.

config VIDEO_AMLOGIC_CAPTURE_OV3640
	tristate "Amlogic Platform Capture Driver for OV3640"
	depends on VIDEO_AMLOGIC_CAPTURE
	select VIDEOBUF_VMALLOC
	select TVIN_BT656IN
	select TVIN_VDIN
	default n
	---help---
	  Amlogic capture driver.
	  Say Y here if you want this driver.

config VIDEO_AMLOGIC_CAPTURE_OV3660
	tristate "Amlogic Platform Capture Driver for OV3660"
	depends on VIDEO_AMLOGIC_CAPTURE
	select VIDEOBUF_VMALLOC
	select TVIN_BT656IN
	select TVIN_VDIN
	default n
	---help---
	  Amlogic capture driver.
	  Say Y here if you want this driver.
	  
config VIDEO_AMLOGIC_CAPTURE_OV5642
	tristate "Amlogic Platform Capture Driver for OV5642"
	depends on VIDEO_AMLOGIC_CAPTURE
	select VIDEOBUF_VMALLOC
	select TVIN_BT656IN
	select TVIN_VDIN
	default n
	---help---
	  Amlogic capture driver.
	  Say Y here if you want this driver.	  

config VIDEO_AMLOGIC_CAPTURE_OV5640
	tristate "Amlogic Platform Capture Driver for OV5640"
	depends on VIDEO_AMLOGIC_CAPTURE
	select VIDEOBUF_VMALLOC
	select TVIN_BT656IN
	select TVIN_VDIN
	default n
	---help---
	  Amlogic capture driver.
	  Say Y here if you want this driver.	  

config VIDEO_AMLOGIC_CAPTURE_OV7675
	tristate "Amlogic Platform Capture Driver for OV7675"
	depends on VIDEO_AMLOGIC_CAPTURE
	select VIDEOBUF_VMALLOC
	select TVIN_BT656IN
	select TVIN_VDIN
	default n
	---help---
	  Amlogic capture driver.
	  Say Y here if you want this driver.
	  
config VIDEO_AMLOGIC_CAPTURE_OV2655
	tristate "Amlogic Platform Capture Driver for OV2655"
	depends on VIDEO_AMLOGIC_CAPTURE
	select VIDEOBUF_VMALLOC
	select TVIN_BT656IN
	select TVIN_VDIN
	default n
	---help---
	  Amlogic capture driver.
	  Say Y here if you want this driver.
	  
config VIDEO_AMLOGIC_CAPTURE_SP0838
	tristate "Amlogic Platform Capture Driver for SP0838"
	depends on VIDEO_AMLOGIC_CAPTURE
	select VIDEOBUF_VMALLOC
	select TVIN_BT656IN
	select TVIN_VDIN
	default n
	---help---
	  Amlogic capture driver.
	  Say Y here if you want this driver.	 	  
	  
config AMLOGIC_VIDEOIN_MANAGER
	tristate
```

## drivers/misc/bosch_bma222/Kconfig
```kconfig
#
# Miscellaneous I2C chip drivers configuration
#
# *** DEPRECATED! Do not add new entries! See Makefile ***
#

menu "Miscellaneous I2C Chip support"





config BOSCH_BMA222
	tristate "BMA222 acceleration sensor support"
	depends on I2C=y
	help
	  If you say yes here you get support for Bosch Sensortec's 
	  acceleration sensors BMA222.

config BOSCH_BMA222_ENABLE_INT1
	tristate "BMA222 acceleration sensor interrupt INT1 support"
	depends on BOSCH_BMA222=y
	help
	  If you say yes here you get INT1 support for Bosch Sensortec's 
	  acceleration sensors BMA222.

config BOSCH_BMA222_ENABLE_INT2
	tristate "BMA222 acceleration sensor interrupt INT2 support"
	depends on BOSCH_BMA222=y
	help
	  If you say yes here you get INT2 support for Bosch Sensortec's 
	  acceleration sensors BMA222.




endmenu
```

## sound/soc/aml/Kconfig
```kconfig
config SND_AML_SOC
	tristate "soc audio for AMLogic Ssystem-on-system"
	depends on ARCH_MESON || ARCH_MESON2 || ARCH_A1H || ARM 
	help
	  Say Y or M if you want to add support for codecs attached to
	  the AMLogic I2S interface. You will also need
	  to select the audio interfaces to support below.
	  
config SND_AML_M1
	tristate "M1 evaluation board with internel audio dac"
	depends on SND_AML_SOC


config SND_AML_M1_MID_WM8900
	tristate "AML6236 MID board with WM8900"
	depends on SND_AML_SOC
        select SND_SOC_WM8900 if SND_AML_M1_MID_WM8900

config SND_AML_M1_ARMDEV_WM8900
	tristate "AML8726M ARM Dev board with WM8900"
	depends on SND_AML_SOC
		select SND_SOC_WM8900 if SND_AML_M1_ARMDEV_WM8900
	
config SND_AML_M1_MID_RT5621
	tristate "AML8726M MID board with RT5621"
	depends on SND_AML_SOC
		select SND_SOC_RT5621 if SND_AML_M1_MID_RT5621
config SND_AML_M2
	tristate "M2 evaluation board with internal audio codec"
	depends on SND_AML_SOC

config SND_AML_M3
	tristate "M3 evaluation board with internal audio codec"
	depends on SND_AML_SOC
	
config SND_AML_M3_CS4334
    tristate "AMLM3 board with CS4334"
    depends on SND_AML_SOC
    select SND_SOC_CS4334 if SND_AML_M3_CS4334
```
