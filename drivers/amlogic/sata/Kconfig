## drivers/amlogic/wifi/Kconfig
```kconfig
menu "Amlogic WIFI Support"

config SDIO_DHD_CDC_WIFI_4319
	bool "Broadcom 4319 wireless cards support"
	depends on SD_MMC
	select WIRELESS_EXT
	select WEXT_PRIV
	---help---
	  This module adds support for wireless adapters based on
	  Broadcom 4319 chipset.

	  This driver uses the kernel's wireless extensions subsystem.
	  You should add bcm4329 firmware and nvram file in directory drivers/amlogic/wifi/
	  
          & assure to set these config in 
	  Device Drivers  ---> Generic Driver Options  ---> 

	  [*]   Include in-kernel firmware blobs in kernel binary  
          (broadcm_4319/nvram_4319_201008.txt broadcm_4319/sdio-g-cdc-full11n-reclaim-roml-wme.bin) External firmware blobs to build into 
	  
config BCM4319_FW_PATH
	depends on SDIO_DHD_CDC_WIFI_4319
	string "BCM4319 Firmware path"
	default "broadcm_4319/sdio-g-cdc-full11n-reclaim-roml-wme.bin"
	---help---
	  Path to the firmware file.

config BCM4319_NVRAM_PATH
	depends on SDIO_DHD_CDC_WIFI_4319
	string "BCM4319 NVRAM path"
	default "broadcm_4319/nvram_4319_201008.txt"
	---help---
	  Path to nvram file.

config SDIO_DHD_CDC_WIFI_4329
	bool "Broadcom 4329 wireless cards support"
	depends on SD_MMC
	select WIRELESS_EXT
	select WEXT_PRIV
	---help---
	  This module adds support for wireless adapters based on
	  Broadcom 4329 chipset.

	  This driver uses the kernel's wireless extensions subsystem.
	  You should add bcm4329 firmware and nvram file in directory drivers/amlogic/wifi/
	  
          & assure to set these config in 
	  Device Drivers  ---> Generic Driver Options  ---> 

	  [*]   Include in-kernel firmware blobs in kernel binary  
          (broadcm_4329/nvram.txt broadcm_4329/sdio-g-cdc-full11n-reclaim-roml-wme-idsup.bin) External firmware blobs to build into 
	  
config BCM4329_FW_PATH
	depends on SDIO_DHD_CDC_WIFI_4329
	string "BCM4329 Firmware path"
	default "broadcm_4329/sdio-g-cdc-full11n-reclaim-roml-wme-idsup.bin"
	---help---
	  Path to the firmware file.

config BCM4329_NVRAM_PATH
	depends on SDIO_DHD_CDC_WIFI_4329
	string "BCM4329 NVRAM path"
	default "broadcm_4329/nvram.txt"
	---help---
	  Path to nvram file.

config SAMSUNG_WIFI_4329
	bool "Samsung 4329 wireless cards support"
	depends on SD_MMC
	select WIRELESS_EXT
	select WEXT_PRIV
---help---
	  This module adds support for wireless adapters based on
	  Samsung Bcm 4329 chipset.

	  This driver uses the kernel's wireless extensions subsystem.
	  You should add bcm4329 firmware and nvram file in directory drivers/amlogic/wifi/
	  
          & assure to set these config in 
	  Device Drivers  ---> Generic Driver Options  ---> 

	  [*]   Include in-kernel firmware blobs in kernel binary  
          (bcm4329/nvram.txt bcm4329/fw_bcm4329.bin) External firmware blobs to build into 
	  
config SAMSUNG_BCM4329_FW_PATH
	depends on SAMSUNG_WIFI_4329
	string "SAMSUNG BCM4329 Firmware path"
	default "bcm4329/fw_bcm4329.bin"
	---help---
	  Path to the firmware file.

config SAMSUNG_BCM4329_NVRAM_PATH
	depends on SAMSUNG_WIFI_4329
	string "SAMSUNG BCM4329 NVRAM path"
	default "bcm4329/nvram.txt"
	---help---
	  Path to nvram file.
	  
config RTL8XXX_SU_USB_WIFI
	tristate "Realtek SU series (8712 8188 8191 8192SU) Wireless USB Dongle support"
	default n
	depends on MAC80211 && USB
	---help---
	  This module adds support for wireless USB dongle based on
	  Realtek 8712 8188 8191 8192SU chipset.

config RTL8XXX_CU_USB_WIFI
	tristate "Realtek CU series (8192 8188CU) Wireless USB Dongle support"
	default n
	depends on MAC80211 && USB
	---help---
	  This module adds support for wireless USB dongle based on
	  Realtek 8192CU chipset.
config RTL8XXX_CU_EXT_POWER_CTRL
	bool "Realtek CU series (8192 8188CU) Wireless USB Dongle power control"
	default n
	depends on RTL8XXX_CU_USB_WIFI
	---help---
	  This config adds support for controlling power of Realtek 8xxxCU series,need define function extern_usb_wifi_power() in bsp first.
	  
config SDIO_ATHEROS_6302_WIFI
	tristate "ATHEROS 6302 wireless cards support"
	depends on SD_MMC
	select WIRELESS_EXT
	select WEXT_PRIV
	---help---
	This module adds support for ATHEROS 6302 wireless cards support.
	
	This driver uses the kernel's wireless extensions subsystem.
	You should add ATHEROS 6302 firmware file in directory firmware/atheros_6302
	
	    & assure to set these config in 
	Device Drivers  ---> Generic Driver Options  ---> 
	
	[*]   Include in-kernel firmware blobs in kernel binary  
	    (atheros_6302/otp.bin.z77 atheros_6302/athwlan.bin.z77 atheros_6302/data.patch.bin atheros_6302/bdata.SD31.bin) External firmware blobs to build into 

config AR6003_REV2_OTP_FILE
	depends on SDIO_ATHEROS_6302_WIFI
	string "ATHEROS_6302 OTP path"
	default "atheros_6302/otp.bin.z77"
	---help---
	  Path to the otp file.
	  
config AR6003_REV2_FIRMWARE_FILE
	depends on SDIO_ATHEROS_6302_WIFI
	string "ATHEROS_6302 FIRMWARE path"
	default "atheros_6302/athwlan.bin.z77"
	---help---
	  Path to the firmware file.
	  
config AR6003_REV2_PATCH_FILE
	depends on SDIO_ATHEROS_6302_WIFI
	string "ATHEROS_6302 PATCH path"
	default "atheros_6302/data.patch.bin"
	---help---
	  Path to the patch file.

config AR6003_REV2_BOARD_DATA_FILE
	depends on SDIO_ATHEROS_6302_WIFI
	string "ATHEROS_6302 BOARD_DATA path"
	default "atheros_6302/bdata.SD31.bin"
	---help---
	  Path to the bdata file.
	  
config SDIO_ATHEROS_6102_WIFI
	bool "ATHEROS 6102 wireless cards support"
	depends on SD_MMC
	select WIRELESS_EXT
	select WEXT_PRIV
	---help---
	This module adds support for ATHEROS 6102 wireless cards support.
	
	This driver uses the kernel's wireless extensions subsystem.
	You should add ATHEROS 6102 firmware file in directory firmware/atheros_6102
	
	    & assure to set these config in 
	Device Drivers  ---> Generic Driver Options  ---> 
	
	[*]   Include in-kernel firmware blobs in kernel binary  
	    (atheros_6102/calData_ar6102_15dBm.bin atheros_6102/athwlan.bin.z77 atheros_6102/data.patch.hw2_0.bin) External firmware blobs to build into 	  
	  	  	  
config AR6102_FIRMWARE_FILE
	depends on SDIO_ATHEROS_6102_WIFI
	string "ATHEROS_6102 FIRMWARE path"
	default "atheros_6102/athwlan.bin.z77"
	---help---
	  Path to the firmware file.
	  
config AR6102_PATCH_FILE
	depends on SDIO_ATHEROS_6102_WIFI
	string "ATHEROS_6102 PATCH path"
	default "atheros_6102/data.patch.hw2_0.bin"
	---help---
	  Path to the patch file.

config AR6102_BOARD_DATA_FILE
	depends on SDIO_ATHEROS_6102_WIFI
	string "ATHEROS_6102 BOARD_DATA path"
	default "atheros_6102/calData_ar6102_15dBm.bin"
	---help---
	  Path to the bdata file.
	  
menuconfig SDIO_MARVELL_NH387_WIFI
	tristate "Marvell nh387 wireless cards support"
	default n
	depends on SD_MMC
	select WIRELESS_EXT
	select WEXT_PRIV
	---help---
	  This module adds support for wireless adapters based on
	  Marvell nh387 chipset.

	  This driver uses the kernel's wireless extensions subsystem.
	  You should add Marvell nh387 firmware and nvram file in directory drivers/amlogic/wifi/
	  
          & assure to set these config in 
	  Device Drivers  ---> Generic Driver Options  ---> 

	  [*]   Include in-kernel firmware blobs in kernel binary  
          (mrvl/sd8787_uapsta.bin mrvl/sd8787_uapsta_w1.bin) External firmware blobs to build into 
if SDIO_MARVELL_NH387_WIFI	  
config SDIO_HARD_IRQ
	depends on SDIO
	bool "SDIO HARD IRQ"
	default y
	---help---
	  hard irq wake up polling process
config MRVLNH387_FW_PATH
	depends on SDIO_MARVELL_NH387_WIFI
	string "MRVLNH387 Firmware path"
	default "mrvl/sd8787_uapsta.bin"
	---help---
	  Path to the firmware file.
config MRVLNH387_W1_FW_PATH
	depends on SDIO_MARVELL_NH387_WIFI
	string "MRVLNH387 Firmware path"
	default "mrvl/sd8787_uapsta_w1"
	---help---
	  Path to firmware file.
config MRVLNH387_DEBUG
	depends on SDIO_MARVELL_NH387_WIFI
	string "MRVLNH387 Debug level n/1/2"
	default "n"
		---help---
	  MRVLNH387 Debug level n/1/2.
config MRVLNH387_PROC_DEBUG
	depends on SDIO_MARVELL_NH387_WIFI
	bool "MRVLNH387 Proc debug file"
	default n
		---help---
	  MRVLNH387 Proc debug file.
config MRVLNH387_STA_SUPPORT
	depends on SDIO_MARVELL_NH387_WIFI
	bool "ENABLE STA mode support"
	default y
		---help---
	  ENABLE STA mode support.
config MRVLNH387_UAP_SUPPORT
	depends on SDIO_MARVELL_NH387_WIFI
	bool "Enable AP mode support"
	default n
		---help---
	  Enable AP mode support.
config MRVLNH387_REASSOCIATION
	depends on SDIO_MARVELL_NH387_WIFI
	bool "Re-association in driver"
	default y
		---help---
	  Re-association in driver.
config MRVLNH387_MFG_CMD_SUPPORT
	depends on SDIO_MARVELL_NH387_WIFI
	bool "Manufacturing firmware support"
	default y
		---help---
	  Manufacturing firmware support.
config MRVLNH387_BIG_ENDIAN
	depends on SDIO_MARVELL_NH387_WIFI
	bool "Big-endian platform"
	default n
		---help---
	  Big-endian platform.
config MRVLNH387_SDIO_MULTI_PORT_TX_AGGR
	depends on SDIO_MARVELL_NH387_WIFI
	bool "Enable SDIO multi-port Tx aggregation"
	default n
		---help---
	  Enable SDIO multi-port Tx aggregation.
config MRVLNH387_SDIO_MULTI_PORT_RX_AGGR
	depends on SDIO_MARVELL_NH387_WIFI
	bool "Enable SDIO multi-port Rx aggregation"
	default n
		---help---
	  Enable SDIO multi-port Rx aggregation.
config MRVLNH387_SDIO_SUSPEND_RESUME
	depends on SDIO_MARVELL_NH387_WIFI
	bool "SDIO suspend/resume"
	default n
		---help---
	  SDIO suspend/resume.
endif

config SDIO_TI_WIFI_WGT7310
	tristate "Ti wgt7310 wireless cards support"
	default n
	depends on SD_MMC
	select WIRELESS_EXT
	select WEXT_PRIV
	---help---
	  This module adds support for wireless adapters based on
	  Ti wgt7310 chipset.

config SDIO_DHD_CDC_WIFI_4319_MODULE
	tristate "Broadcom 4319 wireless cards support"
	depends on SD_MMC
	select WIRELESS_EXT
	select WEXT_PRIV
	---help---
	  This module adds support for wireless adapters based on
	  Broadcom 4319 chipset.

	  
config SDIO_DHD_CDC_WIFI_4329_MODULE
	tristate "Broadcom 4329 wireless cards support"
	depends on SD_MMC
	select WIRELESS_EXT
	select WEXT_PRIV
	---help---
	  This module adds support for wireless adapters based on
	  Broadcom 4329 chipset.

config BCM4329_WIFI_CONTROL_FUNC
	bool "Use bcm4329_wlan device"
	depends on SDIO_DHD_CDC_WIFI_4329_MODULE
	default n
	---help---
	   Use this option to get various parameters from architecture specific
	   bcm4329_wlan platform device. Say n if unsure.

#if BCM4329_WIFI_CONTROL_FUNC

#config BCM4329_DHD_USE_STATIC_BUF
#	bool "Use static buffer"
#	depends on SDIO_DHD_CDC_WIFI_4329_MODULE
#	default n
#	---help---
#	   Use static buffer from kernel heap allocated during bcm4329_wlan
#	   platform device creation.

config BCM4329_HW_OOB
	bool "Use out of band interrupt"
	depends on SDIO_DHD_CDC_WIFI_4329_MODULE
	default n
	---help---
	   Use out of band interrupt for wake on wireless.

config BCM4329_OOB_INTR_ONLY
	bool "Use out of band interrupt only"
	depends on SDIO_DHD_CDC_WIFI_4329_MODULE
	default n
	---help---
	   Use out of band interrupt for all interrupts(including SDIO interrupts).

config SDIO_NRX600
        tristate "NANO NRX600 wireless card support"
        depends on SD_MMC
	select SDIO_HARD_IRQ
        select WIRELESS_EXT
        select WEXT_PRIV
        select SDIO_HARD_IRQ
        ---help---
           SUMSANG NRX600
	      
endmenu
```

## drivers/amlogic/wifi/atheros_ath6kl/ath6kl/Kconfig
```kconfig
config ATH6KL
	tristate

config ATH6KL_SDIO
	tristate "Atheros ath6kl sdio support"
	depends on MMC
	depends on CFG80211
	select ATH6KL
	select WIRELESS_EXT
	select WEXT_PRIV
	---help---
	  This module adds support for wireless adapters based on
	  Atheros AR6003 chipset running over SDIO. If you choose to
	  build it as a module, it will be called ath6kl. Pls note
	  that AR6002 and AR6001 are not supported by this driver.

config ATH6KL_USB
	tristate "Atheros ath6kl usb support"
	depends on CFG80211
	select ATH6KL
	select WIRELESS_EXT
	select WEXT_PRIV
	---help---
	  This module adds support for wireless adapters based on
	  Atheros AR6004/AR6006 chipset running over USB. If you choose to
	  build it as a module, it will be called ath6kl_usb.

config ATH6KL_DEBUG
	bool "Atheros ath6kl debugging"
	depends on ATH6KL
	---help---
	  Enables debug support
```

## drivers/i2c/chips/Kconfig
```kconfig
#
# Miscellaneous I2C chip drivers configuration
#
# *** DEPRECATED! Do not add new entries! See Makefile ***
#

menu "Miscellaneous I2C Chip support"

config SENSORS_MXC622X
	tristate "MEMSIC Accelerometer Sensor MXC622X Driver Support"
	depends on I2C
	help
	  If you say yes here you get support for the MEMSIC accelerometer sensor

config SENSORS_MMA8452
	tristate "MEMSIC Accelerometer Sensor MMA8452 Driver Support"
	depends on I2C
	help
	  If you say yes here you get support for the MEMSIC accelerometer sensor

config SENSORS_MMC31XX
	tristate "MEMSIC Magnetic Sensor MMC31XX Driver Support"
	depends on I2C
	help
	  If you say yes here you get support for the MEMSIC magnateic sensor

config SENSORS_MMC328X
	tristate "MEMSIC Magnetic Sensor MMC328X Driver Support"
	depends on I2C
	help
	  If you say yes here you get support for the MEMSIC magnateic sensor

config ECOMPASS
	tristate "MEMSIC eCompass Driver Support"
	depends on I2C
	help
	  If you say yes here you get support for the MEMSIC eCompass

config INPUT_LSM303_ACCEL
	tristate "LSM303DLH 3-axis accelerometer driver"
	depends on I2C
	help
	  Say Y here if you want to support the built-in LSM303DLH 3-axis accelerometer.

	  To compile this driver as a module, choose M here: the
	  module will be called lsm303dlh_acc.

config INPUT_LSM303_MAGNE
	tristate "LSM303DLH 3-axis magnetometer driver"
	depends on I2C
	help
	  Say Y here if you want to support the built-in LSM303DLH 3-axis magnetometer.

	  To compile this driver as a module, choose M here: the
	  module will be called lsm303dlh_mag.

config INPUT_LSM303DLM_ACCEL
	tristate "LSM303DLM 3-axis accelerometer driver"
	depends on I2C
	help
	  Say Y here if you want to support the built-in LSM303DLM 3-axis accelerometer.

	  To compile this driver as a module, choose M here: the
	  module will be called lsm303dlm_acc.

config INPUT_LSM303DLM_MAGNE
	tristate "LSM303DLM 3-axis magnetometer driver"
	depends on I2C
	help
	  Say Y here if you want to support the built-in LSM303DLM 3-axis magnetometer.

	  To compile this driver as a module, choose M here: the
	  module will be called lsm303dlm_mag.

config INPUT_L3G4200D
	tristate "L3G4200D 3-axis gyroscope driver"
	depends on I2C
	help
	  Say Y here if you want to support the built-in L3G4200D 3-axis gyroscope.

	  To compile this driver as a module, choose M here: the
	  module will be called L3G4200D gyroscope.
endmenu
```
