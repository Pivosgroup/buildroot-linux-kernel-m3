## drivers/amlogic/gpio/Kconfig
```kconfig
menu "Amlogic GPIO Driver"
config  AM_GPIO
	tristate  "gpio module"
	default n
	help 
		gpio module support
endmenu
```

## drivers/amlogic/gps/Kconfig
```kconfig
menu "Amlogic GPS Support"

config GPS_POWERCTRL
	bool "Amlogic gps power control support"
	depends on SERIAL_CORE
	---help---
	  This module adds support for gps power control.
	  
endmenu
```

## drivers/amlogic/hdmi/Kconfig
```kconfig
menu "Amlogic HDMI Support"


config AML_HDMI_TX
        tristate "HDMI output enable"
        default y
        help  
                hdmi output enable,It should be enalbe if board have hdmi out interface

if AML_HDMI_TX
config AML_HDMI_TX_HDCP
        tristate "HDMITX hdcp enable"
        default n
        help  
                hdmitx hdcp enable,It should be enalbe if board have hdmitx hdcp key
endif        
endmenu
```

## drivers/amlogic/i2c/Kconfig
```kconfig
menuconfig AMLOGIC_I2C
        bool "AMLOGIC I2C CONFIG"
if AMLOGIC_I2C
choice	
	prompt "AMLOGIC I2C Hardware Bus support"
        default I2C_SW_AML

config I2C_APOLLO
        bool "APOLLO I2C Controller"
        select I2C
        select I2C_CHARDEV
        help
          If you say yes to this option, support will be included for the I2c
          controller on ARC APOLLO CHIP.

          This driver can also be built as a module.  If so, the module
          will be called i2c-apollo.

config I2C_AML
        bool "Amlogic I2C Driver"
        select I2C
        select I2C_CHARDEV
        select I2C_ALGOBIT
	help
          Yet another Amlogic I2C Driver, normal master

config I2C_SW_AML
        bool "Amlogic software I2C Driver"
        select I2C
        select I2C_CHARDEV
        select I2C_ALGOBIT
	help
          Amlogic software I2C Driver, normal gpio simulate I2C, bit algo
endchoice

endif
```

## drivers/amlogic/input/Kconfig
```kconfig
#
# Input device configuration
#

menu "Amlogic Input device support"

source "drivers/amlogic/input/irremote/Kconfig"

source "drivers/amlogic/input/saradc/Kconfig"

source "drivers/amlogic/input/adc_ts/Kconfig"

source "drivers/amlogic/input/adc_keypad/Kconfig"

source "drivers/amlogic/input/key_input/Kconfig"

source "drivers/amlogic/input/touch_screen/Kconfig"

source "drivers/amlogic/input/touch_keypad/Kconfig"

source "drivers/amlogic/input/vfd/Kconfig"

source "drivers/amlogic/input/irreceiver/Kconfig"

endmenu
```

## drivers/amlogic/input/adc_keypad/Kconfig
```kconfig
#
# Input core configuration
#



config ADC_KEYPADS_AM
	tristate "Amlogic ADC keypad support"
	depends on SARADC_AM
	default n
	help
	  Say Y here if you want to use the amlogic ADC keypad.

	  To compile this driver as a module, choose M here: the
	  module will be called .
```

## drivers/amlogic/input/adc_ts/Kconfig
```kconfig
#
# Input core configuration
#



config ADC_TOUCHSCREEN_AM
	tristate "Amlogic ADC touchscreen support"
	depends on SARADC_AM
	help
	  Say Y here if you want to use the amlogic ADC touchscreen.

	  To compile this driver as a module, choose M here: the
	  module will be called .
```

## drivers/amlogic/input/irreceiver/Kconfig
```kconfig
#
# Input core configuration
#



config AM_IR_RECEIVER
	tristate "Amlogic IR Receiver(Self-study Remote) support"
	default n
	help
	  Say Y here if you want to use the amlogic self-study remote function.

	  To compile this driver as a module, choose M here: the
	  module will be called .
```

## drivers/amlogic/input/irremote/Kconfig
```kconfig
#
# Input core configuration
#



config KEYPADS_AM
	tristate "Amlogic ir remote control support"
	default n
	help
	  Say Y here if you want to use the amlogic remote control.

	  To compile this driver as a module, choose M here: the
	  module will be called .

config VIRTUAL_REMOTE
	tristate "Amlogic virtual ir remote support (only for QA test)"
	default n
	help
	  Say Y here if you want to use the virtual remote keypad.
	  It can fill a series of key events into input device for QA
	  test UI code.

	  To compile this driver as a module, choose M here: the
	  module will be called .
```

## drivers/amlogic/input/key_input/Kconfig
```kconfig
#
# Input core configuration
#



config KEY_INPUT_CUSTOM_AM
	tristate "Amlogic Key Input(custom) support"
	default n
	help
	  Say Y here if you want to use the amlogic Key Input(custom).

	  To compile this driver as a module, choose M here: the
	  module will be called .
```

## drivers/amlogic/input/saradc/Kconfig
```kconfig
#
# Input core configuration
#



config SARADC_AM
	tristate "Amlogic SARADC support"
	default n
	help
	  Say Y here if you want to use the amlogic SARADC.

	  To compile this driver as a module, choose M here: the
	  module will be called .
```

## drivers/amlogic/input/touch_keypad/Kconfig
```kconfig
#
# Input core configuration
#

config TOUCH_KEY_PAD_IT7230
	tristate "IT7230 touch key pad support"
	default n
	help
	  Say Y here if you want to use the IT7230 touch key pad support.

	  To compile this driver as a module, choose M here: the
	  module will be called .

config TOUCH_KEY_PAD_SO340010
	tristate "SO340010 capacitive keypad support"
	default n
	help
	  Say Y here if you want to use the SO340010 capacitive keypad.

	  To compile this driver as a module, choose M here: the
	  module will be called .
```

## drivers/amlogic/input/touch_screen/Kconfig
```kconfig
#
# Input core configuration
#

config SINTEK_CAPACITIVE_TOUCHSCREEN
	tristate "Sintek capacitive touch panel"
	default n
	help
	  Say Y here if you want to use the Sintek capacitive panel.

	  To compile this driver as a module, choose M here: the
	  module will be called .

config ZET6221_CAPACITIVE_TOUCHSCREEN
	tristate "ZET6221 capacitive touch panel"
	default n
	help
	  Say Y here if you want to use the ITK capacitive panel.

	  To compile this driver as a module, choose M here: the
	  module will be called .

config SSD2533_CAPACITIVE_TOUCHSCREEN
	tristate "SSD2533 capacitive touch panel"
	default n
	help
	  Say Y here if you want to use the ITK capacitive panel.

	  To compile this driver as a module, choose M here: the
	  module will be called .


config ITK_CAPACITIVE_TOUCHSCREEN
	tristate "ITK capacitive touch panel"
	default n
	help
	  Say Y here if you want to use the ITK capacitive panel.

	  To compile this driver as a module, choose M here: the
	  module will be called .

config EETI_CAPACITIVE_TOUCHSCREEN
	tristate "EETI capacitive touch panel"
	default n
	help
	  Say Y here if you want to use the EETI capacitive panel.

	  To compile this driver as a module, choose M here: the
	  module will be called .

config SIS92XX_CAPACITIVE_TOUCHSCREEN
	tristate "sis92xx capacitive touch panel"
	depends on I2C
	default n
	help
	  Say Y here if you want to use the sis92xx capacitive panel.

	  To compile this driver as a module, choose M here: the
	  module will be called .
	  
config FOCALTECH_CAPACITIVE_TOUCHSCREEN
	tristate "focaltech capacitive touch panel"
	depends on I2C
	default n
	help
	  Say Y here if you want to use the focaltech 5x06 capacitive panel.

	  To compile this driver as a module, choose M here: the
	  module will be called .

config FOCALTECH_TOUCHSCREEN_CODE_UPG
	tristate "focaltech capacitive touch panel support upgrade"
	depends on I2C
	default n
	help
	  Say Y here if you want to use the focaltech 5x06 capacitive panel.

	  To compile this driver as a module, choose M here: the
	  module will be called .


config HX8520_CAPACITIVE_TOUCHSCREEN
	tristate "HX8520 capacitive touch panel"
	depends on I2C
	default n
	help
	  Say Y here if you want to use the HX8520 capacitive panel.

	  To compile this driver as a module, choose M here: the
	  module will be called .
	  
config RAYDIUM_CAPACITIVE_TOUCHSCREEN
	tristate "Raydium capacitive touch panel"
	depends on I2C
	default n
	help
	  Say Y here if you want to use the Raydium capacitive panel.

	  To compile this driver as a module, choose M here: the
	  module will be called .
	  
config GOODIX_CAPACITIVE_TOUCHSCREEN
	tristate "Goodix capacitive touch panel"
	depends on I2C
	default n
	help
	  Say Y here if you want to use the Goodix capacitive panel.

	  To compile this driver as a module, choose M here: the
	  module will be called .

config GOODIX_GT819_CAPACITIVE_TOUCHSCREEN
	tristate "Goodix GT819 capacitive touch panel"
	depends on I2C
	default n
	help
	  Say Y here if you want to use the Goodix GT819 capacitive panel.

	  To compile this driver as a module, choose M here: the
	  module will be called .

config GOODIX_GT82X_CAPACITIVE_TOUCHSCREEN
	tristate "Goodix GT828X capacitive touch panel"
	depends on I2C
	default n
	help
	  Say Y here if you want to use the Goodix GT828X capacitive panel.

	  To compile this driver as a module, choose M here: the
	  module will be called .

config UOR7X5X_RESISTIVE_TOUCHSCREEN
	tristate "UOR7X5X resistive touch panel"
	default n
	help
	  Say Y here if you want to use the UOR7X5X resistive panel.

	  To compile this driver as a module, choose M here: the
	  module will be called .  
config UOR6X5X_RESISTIVE_TOUCHSCREEN
	tristate "UOR6X5X resistive touch panel"
	default n
	help
	  Say Y here if you want to use the UOR6X5X resistive panel.

config PIXCIR_CAPACITIVE_TOUCHSCREEN
	tristate "pixcir capacitive touch panel"
	depends on I2C
	default n
	help
	  Say Y here if you want to use the pixcir capacitive panel.

	  To compile this driver as a module, choose M here: the
	  module will be called .  

config IT7260_CAPACITIVE_TOUCHSCREEN
	tristate "ite it7260 capacitive touch panel"
	depends on I2C
	default n
	help
	  Say Y here if you want to use the it7260 capacitive panel.

	  To compile this driver as a module, choose M here: the
	  module will be called .  
	  
config SSD25XX_CAPACITIVE_TOUCHSCREEN
	tristate "SSD25XX capacitive touch panel"
	depends on I2C
	default n
	help
	  Say Y here if you want to use the SSD25XX capacitive panel.

	  To compile this driver as a module, choose M here: the
	  module will be called .  
config TOUCHSCREEN_SIS_I2C
	tristate "SiS 9200 family I2C touchscreen driver"
	depends on I2C
	default n
	help
	  This enables support for SiS 9200 family over I2C based touchscreens.	  

	  To compile this driver as a module, choose M here: the
	  module will be called .  
	  
```

## drivers/amlogic/input/vfd/Kconfig
```kconfig
#
# VFD configuration
#

config VFD_ENABLE
	tristate "VFD support"
	default n
	help
	  Say Y here if you want to use the amlogic VFD control.

	  To compile this driver as a module, choose M here: the
	  module will be called .

config VFD_SM1628
	depends on VFD_ENABLE
	bool "SM1628 MCU support"
	default n
	help
	  Use SM1628 MCU as controller
```

## drivers/amlogic/jpeglogo/Kconfig
```kconfig
#
# JPEGLOGO device configuration
#

menu "AMLOGIC HW jpeg logo driver"

config JPEGLOGO
    bool "AMLOGIC HW jpeg logo driver"
    default n
	help
	  Select to enable JPEG logo driver.

config JPEGLOGO_ADDR
    hex "JPEG logo data address"
    depends on JPEGLOGO
    default 0x85800000
	help
	  JPEG logo data address.

config JPEGLOGO_SIZE
    int "JPEG logo data size"
    depends on JPEGLOGO
    default 102400
	help
	  JPEG logo data size.

endmenu
```

## drivers/amlogic/light_sensor/Kconfig
```kconfig
menu "Amlogic Light Sensor Support"

config LS_GL3526
	bool "ADC Light Sensor - GL3526"
	select INPUT_POLLDEV
	default n
	---help---
	  This module adds support for adc light sensor gl3526

config LS_ON9658
	bool "ADC Light Sensor - ON9658"
	select INPUT_POLLDEV
	default n
	---help---
	  This module adds support for adc light sensor on9658

endmenu
```

## drivers/amlogic/mali/Kconfig
```kconfig
#
# Mali 400 GPU OpenGL device driver
#

menu "Mali 400 GPU OpenGL device driver"

config MALI
	tristate "Mali 400 GPU OpenGL device driver"
	depends on m
	default m
	help
	  Enable kernel module build for Mali 400 OpenGL device driver.

endmenu
```

## drivers/amlogic/minilvds/Kconfig
```kconfig
menu "MINI LVDS Support"


config TWX_TC101
	bool "TWX_TC101 mini LVDS support"
	depends on I2C_AML
	---help---
	  This module adds support for twx_tc101 mini LVDS

endmenu
```

## drivers/amlogic/modem/Kconfig
```kconfig
menu "Amlogic intenal modem  Support"

config AMLOGIC_MODEM
	bool "Amlogic intenal modem  support"
	select IN_3G_SUPPLY
	default n
	help
	  Say Y here if you want to use the amlogic intenal modem management.
	  
endmenu
```

## drivers/amlogic/nand/Kconfig
```kconfig
#
# Amlogic NAND device configuration
#

menu "AMLOGIC NAND Flash support"

config AM_NAND
	bool "Amlogic NAND FLASH M1/M2/M3 SUPPORT"
	    depends on AMLOGIC_SERIES
	default y
        select MTD_NAND 
	    select MTD_PARTITIONS
        select MTD_BLOCK
        select MTD_CHAR
        help
		This is Meson_M1 nand suport

config AM_NAND_RBPIN
	bool "use nand rbpin (A3/M3 optional)"
	    depends on AM_NAND
	default y
	
config AML_NAND_ENV
	bool "use aml nand env (/dev/nand_env)"
	    depends on AM_NAND
	default y
				
config AML_NFTL
	tristate "Amlogic NFTL (NAND Flash Translation Layer) support"
	depends on (AM_NAND)
	default m
        help
		This is aml nftl suport
endmenu
```

## drivers/amlogic/net/Kconfig
```kconfig
#
# DCA server configuration
#
menu "Amlogic Net Device Support"

config AM_ETHERNET
	tristate "Amloigc Ethetnet support"
	depends on  NET
	
config AM_ETHERNET_DEBUG_LEVEL
	int "Amloigc Ethetnet debug level support"
	default 1
	depends on  NET && AM_ETHERNET
	help
		debug level:
		// >0 for basic init and remove debug;
		// >1 further setting debug;
		// >2 for tx
		// >3 for rx


endmenu
```

## drivers/amlogic/power/Kconfig
```kconfig
menu "Amlogic Power Management Support"

config AMLOGIC_PM
	bool "Amlogic Power support"
	select POWER_SUPPLY
	default n
	help
	  Say Y here if you want to use the amlogic power management.

config SMBA10XX_BATTERY
	boolean "SMBA10XX battery driver support"
	depends on I2C_AML
	default n
	help
	  Say Y if you want to add battery driver supoort for SMBA10XX
	  
config BQ27x00_BATTERY
	bool "BQ27x00 Battery support"
	select POWER_SUPPLY
	depends on I2C_AML	
	default n
	help
	  Say Y here if you want to add battery driver supoort for bq27x00.

config STV_MBX_POWEROFF
	bool "Amlogic STV-MBX-M3 poweroff"
	depends on (MACH_MESON_STV_MBX_M3 || MACH_MESON3_STV_MBX_MC) && I2C_SW_AML
        default n
        help
          Say Y here if you want to add power off driver supoort for stv-mbx platform.

source "drivers/amlogic/power/act8xxx_pmu/Kconfig"
source "drivers/amlogic/power/axp_power/Kconfig"
endmenu
```

## drivers/amlogic/power/act8xxx_pmu/Kconfig
```kconfig
config PMU_ACT8xxx
	bool "PMU ACT8942/ACT8862 Driver"
	help
	  This is the pmu act8942/act8862 driver.

	  If unsure, say N.

config PMU_ACT8942
	bool "PMU ACT8942(with charging management)"
	select POWER_SUPPLY
	depends on PMU_ACT8xxx
	default optional
	help
	  pmu act8942(with charging management).

config PMU_ACT8862
	bool "PMU ACT8862(without charging management)"
	depends on PMU_ACT8xxx
	default optional
	help
	  pmu act8862(without charging management).
```

## drivers/amlogic/ppmgr/Kconfig
```kconfig
#
# Post Process Manager device configuration
#

menu "AMLOGIC Post Process Manager driver"

config POST_PROCESS_MANAGER
    tristate "AMLOGIC Post Process Manager driver"
    default n
	help
	  Select to enable AMLOGIC Post Process Manager driver.
config POST_PROCESS_MANAGER_PPSCALER
    tristate "AMLOGIC Post Process Manager PPScaler mode"
    depends on  POST_PROCESS_MANAGER
    default n
	help
	  Select to include PPscaler function in AMLOGIC Post Process Manager driver.
endmenu
```

## drivers/amlogic/rtc/Kconfig
```kconfig
#support amlogic rtc

menu "Amlogic RTC support"

if !RTC_CLASS
comment "Need config 'Real Time Clock'"
endif

config AML_RTC
		bool "Amlogic RTC support"
		default n
		depends on AMLOGIC_SERIES && RTC_CLASS
		
		help
		  This is amlogic inernal rtc driver
		  
endmenu
```
